## src/application/samples/mydemo/13_ad8232_sle/Kconfig
```kconfig
choice
    prompt "Select AD8232 ECG SLE role"
    default SAMPLE_SUPPORT_AD8232_SLE_SERVER
    depends on SAMPLE_SUPPORT_AD8232_SLE
    config SAMPLE_SUPPORT_AD8232_SLE_SERVER
        bool "Enable AD8232 ECG SLE Server sample."
    config SAMPLE_SUPPORT_AD8232_SLE_CLIENT
        bool "Enable AD8232 ECG SLE Client sample."
endchoice

config SUPPORT_SLE_PERIPHERAL
    bool
    default y if (SAMPLE_SUPPORT_AD8232_SLE_SERVER)

config SUPPORT_SLE_CENTRAL
    bool
    default y if (SAMPLE_SUPPORT_AD8232_SLE_CLIENT)
```

## src/application/samples/mydemo/15_emqx_telemetry/Kconfig
```kconfig
menu "EMQX Telemetry Configuration"

config SAMPLE_SUPPORT_EMQX_TELEMETRY
    bool
    prompt "Support shared EMQX telemetry state."
    default n
    depends on ENABLE_MYDEMO_SAMPLE
    help
        Enable shared telemetry state used by ECG, SpO2 and EMQX publishing samples.

config SAMPLE_SUPPORT_EMQX_TELEMETRY_PUBLISHER
    bool
    prompt "Publish telemetry to EMQX over MQTT TLS."
    default n
    depends on SAMPLE_SUPPORT_EMQX_TELEMETRY
    help
        Connect Wi-Fi and publish latest telemetry JSON to EMQX topic hispark/bed01/telemetry.

if SAMPLE_SUPPORT_EMQX_TELEMETRY_PUBLISHER

config WIFI_SSID
    string "Set WIFI SSID for EMQX telemetry"
    default "my_softAP"

config WIFI_PWD
    string "Set WIFI password for EMQX telemetry"
    default "my_password"


config EMQX_MQTT_USERNAME
    string "Set EMQX MQTT username"
    default "ws63_server"

config EMQX_MQTT_PASSWORD
    string "Set EMQX MQTT password"
    default "123456"
endif

endmenu
```

## src/application/samples/mydemo/17_gt_health_sle/Kconfig
```kconfig
config SUPPORT_SLE_CENTRAL
    bool
    default y if SAMPLE_SUPPORT_GT_HEALTH_SLE
```

## src/application/samples/mydemo/Kconfig
```kconfig
# src/application/samples/mydemo/Kconfig

config SAMPLE_SUPPORT_HELLOWORLD
    bool
    prompt "Support HELLOWORLD Sample."
    default n
    depends on ENABLE_MYDEMO_SAMPLE
    help
        This option means support HELLOWORLD Sample.

config SAMPLE_SUPPORT_THREAD
    bool
    prompt "Support THREAD Sample."
    default n
    depends on ENABLE_MYDEMO_SAMPLE
    help
        This option means support THREAD Sample.

config SAMPLE_SUPPORT_MUTEX
    bool
    prompt "Support MUTEX Sample."
    default n
    depends on ENABLE_MYDEMO_SAMPLE
    help
        This option means support MUTEX Sample.

config SAMPLE_SUPPORT_QUEUE
    bool
    prompt "Support QUEUE Sample."
    default n
    depends on ENABLE_MYDEMO_SAMPLE
    help
        This option means support QUEUE Sample.   

config SAMPLE_SUPPORT_EVENT
    bool
    prompt "Support EVENT Sample."
    default n
    depends on ENABLE_MYDEMO_SAMPLE
    help
        This option means support EVENT Sample.   

config SAMPLE_SUPPORT_TIMER
    bool
    prompt "Support TIMER Sample."
    default n
    depends on ENABLE_MYDEMO_SAMPLE
    help
        This option means support TIMER Sample.   

config SAMPLE_SUPPORT_GPIO
    bool
    prompt "Support GPIO Sample."
    default n
    depends on ENABLE_MYDEMO_SAMPLE
    help
        This option means support GPIO Sample.

config SAMPLE_SUPPORT_ADC
    bool
    prompt "Support ADC Sample."
    default n
    depends on ENABLE_MYDEMO_SAMPLE
    help
        This option means support ADC Sample.           

config SAMPLE_SUPPORT_IIC
    bool
    prompt "Support IIC Sample."
    default n
    depends on ENABLE_MYDEMO_SAMPLE
    help
        This option means support IIC Sample.

osource "application/samples/mydemo/15_emqx_telemetry/Kconfig"

config SAMPLE_SUPPORT_AD8232_ADC
    bool
    prompt "Support AD8232 ECG ADC Sample."
    default n
    depends on ENABLE_MYDEMO_SAMPLE
    help
        This option means support AD8232 ECG ADC Sample.

config SAMPLE_SUPPORT_SPO2_SENSOR
    bool
    prompt "Support MAX30102 SpO2 Sensor Sample."
    default n
    depends on ENABLE_MYDEMO_SAMPLE
    help
        This option means support MAX30102 SpO2 raw PPG debug UART sample.

config SAMPLE_SUPPORT_WIFI
    bool
    prompt "Support WIFI Sample."
    default y
    depends on ENABLE_MYDEMO_SAMPLE
    help
        This option means support WIFI Sample.

config SAMPLE_SUPPORT_SLE
    bool
    prompt "Support SLE Sample."
    default y
    depends on ENABLE_MYDEMO_SAMPLE
    help
        This option means support SLE Sample.

if SAMPLE_SUPPORT_SLE
choice
    prompt "Select mydemo SLE sample"
    default SAMPLE_SUPPORT_SLE_UART
    config SAMPLE_SUPPORT_SLE_UART
        bool "Support SLE UART passthrough sample."
    config SAMPLE_SUPPORT_AD8232_SLE
        bool "Support AD8232 ECG SLE transport sample."
endchoice

if SAMPLE_SUPPORT_SLE_UART
osource "application/samples/mydemo/12_sle/Kconfig"
endif

if SAMPLE_SUPPORT_AD8232_SLE
osource "application/samples/mydemo/13_ad8232_sle/Kconfig"
endif
endif
```

## src/open_source/Kconfig
```kconfig
#===============================================================================
# @brief    Kconfig file.
# Copyright (c) HiSilicon (Shanghai) Technologies Co., Ltd. 2026-2026. All rights reserved.
#===============================================================================
menu "Open Source Components"

config OPEN_SOURCE_LVGL
    bool "Enable LVGL (Light and Versatile Graphics Library)"
    default n
    help
        LVGL v9.4.0 embedded graphics library for building UIs.
        When enabled, sources under open_source/lvgl/ will be compiled.

        If your project does not need a GUI, disable this to reduce
        build time and firmware size.

if OPEN_SOURCE_LVGL
osource "open_source/lvgl/Kconfig"
endif

endmenu
```
